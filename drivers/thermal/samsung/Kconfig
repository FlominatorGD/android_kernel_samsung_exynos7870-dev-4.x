## drivers/thermal/samsung/Kconfig
```kconfig
config EXYNOS_THERMAL
	tristate "Exynos thermal management unit driver"
	depends on THERMAL_OF
	depends on HAS_IOMEM
	help
	  If you say yes here you get support for the TMU (Thermal Management
	  Unit) driver for SAMSUNG EXYNOS series of SoCs. This driver initialises
	  the TMU, reports temperature and handles cooling action if defined.
	  This driver uses the Exynos core thermal APIs and TMU configuration
	  data from the supported SoCs.

config EXYNOS_THERMAL_CORE
	bool "Exynos7870 thermal management unit driver"
	depends on SOC_EXYNOS7870
	help
	  If you say yes here you get support for the Exynos7870 TMU
	  (Thermal Management Unit) driver taken from the 3.18 based
	  samsungexynos7870 lineage-20 kernel, including the per-sensor
	  CPUCL0/CPUCL1/G3D trigger points, cpufreq/gpufreq cooling and
	  cluster hotplug throttling configured from the device tree.
	  The 4.14 Exynos thermal driver above it handles the Exynos9820
	  based SoCs, so the two coexist and only match their own SoC.

config EXYNOS_ACPM_THERMAL
	bool
	prompt "Exynos ACPM TMU plug-in support"
	depends on EXYNOS_THERMAL
	help
	  This feature supports ACPM TMU plug-in for Exynos thermal driver.
```

## drivers/video/fbdev/exynos/Kconfig
```kconfig
if SOC_EXYNOS9820 || SOC_EXYNOS9810

source "drivers/video/fbdev/exynos/dpu20/Kconfig"
source "drivers/video/fbdev/exynos/panel/Kconfig"

endif # SOC_EXYNOS9820

if SOC_EXYNOS7870
source "drivers/video/fbdev/exynos/decon_7870/Kconfig"
endif # SOC_EXYNOS7870
```
